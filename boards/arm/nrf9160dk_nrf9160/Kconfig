## boards/arm/nrf9160dk_nrf9160/Kconfig
```kconfig
# nRF9160 DK board configuration

# Copyright (c) 2019 Nordic Semiconductor ASA
# SPDX-License-Identifier: Apache-2.0

config UART_BLE
	bool "UART to BLE enable"
	default y
	help
	  Enable uart_ble_send()
```

## boards/arm/nrf9160dk_nrf9160/nrf9160dk_nrf9160_defconfig
```kconfig
# SPDX-License-Identifier: Apache-2.0

CONFIG_SOC_SERIES_NRF91X=y
CONFIG_SOC_NRF9160_SICA=y
CONFIG_BOARD_NRF9160DK_NRF9160=y

# Enable MPU
CONFIG_ARM_MPU=y

# Enable hardware stack protection
CONFIG_HW_STACK_PROTECTION=y

# Enable TrustZone-M
CONFIG_ARM_TRUSTZONE_M=y

# enable GPIO
CONFIG_GPIO=y

# Enable uart driver
CONFIG_SERIAL=y

# enable console
CONFIG_CONSOLE=y
CONFIG_UART_CONSOLE=y

CONFIG_PINCTRL=y

# tracing output
#CONFIG_TRACING=y
#CONFIG_TRACING_ASYNC=y
#CONFIG_TRACING_TEST=y
#CONFIG_TRACING_BACKEND_UART=y
#CONFIG_TRACING_BUFFER_SIZE=4096
#CONFIG_TRACING_BACKEND_UART_NAME="UART_1"
```

## boards/arm/nrf9160dk_nrf9160/nrf9160dk_nrf9160_ns_defconfig
```kconfig
# SPDX-License-Identifier: Apache-2.0

CONFIG_SOC_SERIES_NRF91X=y
CONFIG_SOC_NRF9160_SICA=y
CONFIG_BOARD_NRF9160DK_NRF9160_NS=y

# Enable MPU
CONFIG_ARM_MPU=y

# Enable hardware stack protection
CONFIG_HW_STACK_PROTECTION=y

# Enable TrustZone-M
CONFIG_ARM_TRUSTZONE_M=y

# This Board implies building Non-Secure firmware
CONFIG_TRUSTED_EXECUTION_NONSECURE=y

# enable GPIO
CONFIG_GPIO=y

# Enable uart driver
CONFIG_SERIAL=y

# enable console
CONFIG_CONSOLE=y
CONFIG_UART_CONSOLE=y

CONFIG_PINCTRL=y

# tracing output
#CONFIG_TRACING=y
#CONFIG_TRACING_ASYNC=y
#CONFIG_TRACING_TEST=y
#CONFIG_TRACING_BACKEND_UART=y
#CONFIG_TRACING_BUFFER_SIZE=4096
#CONFIG_TRACING_BACKEND_UART_NAME="UART_1"

# UART
CONFIG_SERIAL=y
CONFIG_UART_INTERRUPT_DRIVEN=y
CONFIG_UART_0_INTERRUPT_DRIVEN=n
CONFIG_UART_1_INTERRUPT_DRIVEN=n
CONFIG_UART_LINE_CTRL=y
CONFIG_UART_ASYNC_API=y
CONFIG_UART_0_ASYNC=y
CONFIG_UART_1_ASYNC=y
CONFIG_UART_0_NRF_HW_ASYNC=y
CONFIG_UART_1_NRF_HW_ASYNC=y
CONFIG_UART_0_NRF_HW_ASYNC_TIMER=1
CONFIG_UART_1_NRF_HW_ASYNC_TIMER=2
#-CONFIG_NRFX_UARTE=y
#-CONFIG_NRFX_UARTE0=y
#-CONFIG_NRFX_UARTE1=y
#-CONFIG_NRFX_TIMER=y
#-CONFIG_NRFX_TIMER1=y
#-CONFIG_NRFX_TIMER2=y
```
