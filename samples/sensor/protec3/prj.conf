## CMakeLists.txt
```
# SPDX-License-Identifier: Apache-2.0

cmake_minimum_required(VERSION 3.13.1)
find_package(Zephyr HINTS $ENV{ZEPHYR_BASE})
project(protect3_test)

target_sources(app PRIVATE src/main.c)
target_sources(app PRIVATE src/buzzer.c)
target_sources(app PRIVATE src/lte_link.c)
target_sources(app PRIVATE src/notify_sms.c)
target_sources(app PRIVATE src/fota_update.c)
target_sources(app PRIVATE src/mqtt_handler.c)
target_sources(app PRIVATE src/apn.c)
target_sources(app PRIVATE src/aws.c)
target_sources(app PRIVATE src/uart.c)
target_sources(app PRIVATE src/gpio_t.c)
target_sources(app PRIVATE src/iis2dlpc.c)
target_sources(app PRIVATE src/bme280.c)
target_sources(app PRIVATE src/BME280_driver-bme280_v3.5.0/bme280.c)
target_sources(app PRIVATE src/shtc3.c)
target_sources(app PRIVATE src/shtc3/shtc3.c)

zephyr_include_directories(src)
```

## Kconfig
```
#
# Copyright (c) 2018 Nordic Semiconductor ASA
#
# SPDX-License-Identifier: LicenseRef-BSD-5-Clause-Nordic
#

menu "Protec3"

config APPLICATION_WORKQUEUE_STACK_SIZE
	int "Application workqueue stack size"
	default 4096

config MESSAGE_BUFFER_SIZE
	int "snprintf Buffer Size (by Mahouni)"
	default 256

config APPLICATION_WORKQUEUE_PRIORITY
	int "Application workqueue priority"
	default SYSTEM_WORKQUEUE_PRIORITY

config ASSET_TRACKER_WATCHDOG_TIMEOUT_MSEC
	int "Watchdog timeout in milliseconds"
	default 10000

config USE_AT_HOST
	bool "Enable AT commands"
	default y
	select AT_HOST_LIBRARY
	help
	  Enable the AT host library so that AT commands can be sent to and
	  received from a serial terminal.

config UPDATE_HOST
	string "Download host name"
	default "euros-embedded.s3.eu-central-1.amazonaws.com"

config UPDATE_FILE
	string "The file to download"
	default "app_update.bin"

config UPDATE_VERSION
	int "Application version"
	default 1

config UPDATE_USE_HTTPS
	bool
	prompt "Use HTTPS for download"
	default n

endmenu

menu "Zephyr Kernel"
source "Kconfig.zephyr"
endmenu

module = PROTEC3
module-str = Protec3
source "${ZEPHYR_BASE}/subsys/logging/Kconfig.template.log_config"
```

## prj.conf
```kconfig
# My config
CONFIG_GPIO=y
CONFIG_SERIAL=y
CONFIG_UART_INTERRUPT_DRIVEN=y
CONFIG_PWM=y
CONFIG_HWINFO=y

# General config
CONFIG_NEWLIB_LIBC=y
CONFIG_NEWLIB_LIBC_FLOAT_PRINTF=y
CONFIG_ASSERT=y
CONFIG_REBOOT=y
CONFIG_LOG=y

# Network
CONFIG_NETWORKING=y
CONFIG_NET_NATIVE=n
CONFIG_NET_SOCKETS=y
CONFIG_NET_SOCKETS_OFFLOAD=y

# LTE link control
#CONFIG_POWER_OPTIMIZATION_ENABLE=n
CONFIG_LTE_LINK_CONTROL=y
CONFIG_LTE_NETWORK_MODE_LTE_M=n
#CONFIG_LTE_NETWORK_MODE_LTE_M_GPS=n
CONFIG_LTE_AUTO_INIT_AND_CONNECT=n
#CONFIG_LTE_LINK_CONTROL_LOG_LEVEL_DBG=y
CONFIG_LTE_NETWORK_USE_FALLBACK=n

CONFIG_LTE_NETWORK_MODE_NBIOT=y
#CONFIG_LTE_NETWORK_MODE_NBIOT_GPS=n
CONFIG_LTE_PSM_REQ_RPTAU="00000110"
CONFIG_LTE_PSM_REQ_RAT="00000010"

# Modem info
CONFIG_MODEM_INFO=y

# BSD library
CONFIG_BSD_LIBRARY=y
CONFIG_BSD_LIBRARY_TRACE_ENABLED=n

# Console
CONFIG_CONSOLE_SUBSYS=y
CONFIG_CONSOLE_HANDLER=y
CONFIG_CONSOLE_GETCHAR=y

# Heap and stacks
CONFIG_HEAP_MEM_POOL_SIZE=16384
CONFIG_MAIN_STACK_SIZE=8192
CONFIG_SYSTEM_WORKQUEUE_STACK_SIZE=2048
CONFIG_HW_STACK_PROTECTION=y

# Flash
CONFIG_FLASH=y
#CONFIG_IMG_ERASE_PROGRESSIVELY=y

# Fatal error
CONFIG_RESET_ON_FATAL_ERROR=y
CONFIG_WATCHDOG=n

# Drivers
CONFIG_SENSOR=y
#CONFIG_BME280=y
CONFIG_IIS2DLPC=y
CONFIG_EEPROM=y
CONFIG_EEPROM_AT24=y


## FOTA additions ##

# General config
CONFIG_NCS_SAMPLES_DEFAULTS=y

# Image manager
CONFIG_IMG_MANAGER=y
CONFIG_IMG_ERASE_PROGRESSIVELY=y

# FOTA library
CONFIG_FOTA_DOWNLOAD=y

# Download client
CONFIG_DOWNLOAD_CLIENT=y
CONFIG_DOWNLOAD_CLIENT_STACK_SIZE=4096

CONFIG_NORDIC_SECURITY_BACKEND=y
CONFIG_JSON_LIBRARY=y

# DFU Target
CONFIG_DFU_TARGET=y

# Application Upgrade support
CONFIG_BOOTLOADER_MCUBOOT=y

# Sample configuration
#CONFIG_UPDATE_HOST="euros-embedded.s3.eu-central-1.amazonaws.com"
#CONFIG_UPDATE_HOST="gvalkov.com"
CONFIG_UPDATE_HOST="protec3.io:888"
#CONFIG_UPDATE_HOST="87.118.177.198"
#CONFIG_UPDATE_HOST="87.138.172.131"
CONFIG_UPDATE_FILE="/update/app_update.bin"
CONFIG_UPDATE_VERSION=1
CONFIG_UPDATE_USE_HTTPS=n

# APN provision, needed by AT&T cards
# depricated: PDP
#CONFIG_LTE_PDP_CMD=y
#CONFIG_LTE_PDP_CONTEXT="1,\"IP\",\"lp.swir\""
#CONFIG_LTE_PDP_CONTEXT="1,\"IP\",\"iot.aer.net\""
# MQTT
CONFIG_MQTT_LIB=y
CONFIG_MQTT_LIB_TLS=y

CONFIG_MODEM_KEY_MGMT=y
```

## src/adp536x-mod.h
```c
/*
 * Copyright (c) 2019 Nordic Semiconductor ASA
 *
 * SPDX-License-Identifier: LicenseRef-BSD-5-Clause-Nordic
 */

#ifndef ADP536X_H_
#define ADP536X_H_

/**@file adp536x.h
 *
 * @brief Driver for ADP536X.
 * @defgroup adp536x Driver for ADP536X
 * @{
 */

#include <zephyr.h>

/* Definition of VBUS current limit values. */
#define ADP536X_VBUS_ILIM_50mA		0x00
#define ADP536X_VBUS_ILIM_100mA		0x01
#define ADP536X_VBUS_ILIM_150mA		0x02
#define ADP536X_VBUS_ILIM_200mA		0x03
#define ADP536X_VBUS_ILIM_250mA		0x04
#define ADP536X_VBUS_ILIM_300mA		0x05
#define ADP536X_VBUS_ILIM_400mA		0x06
#define ADP536X_VBUS_ILIM_500mA		0x07

/* Definition of charging current values. */
#define ADP536X_CHG_CURRENT_10mA        0x00
#define ADP536X_CHG_CURRENT_50mA        0x04
#define ADP536X_CHG_CURRENT_100mA	0x09
#define ADP536X_CHG_CURRENT_150mA	0x0E
#define ADP536X_CHG_CURRENT_200mA	0x13
#define ADP536X_CHG_CURRENT_250mA	0x18
#define ADP536X_CHG_CURRENT_300mA	0x1D
#define ADP536X_CHG_CURRENT_320mA	0x1F

/* Definition of overcharge protection threshold values. */
#define ADP536X_OC_CHG_THRESHOLD_25mA	0x00
#define ADP536X_OC_CHG_THRESHOLD_50mA	0x01
#define ADP536X_OC_CHG_THRESHOLD_100mA	0x02
#define ADP536X_OC_CHG_THRESHOLD_150mA	0x03
#define ADP536X_OC_CHG_THRESHOLD_200mA	0x04
#define ADP536X_OC_CHG_THRESHOLD_250mA	0x05
#define ADP536X_OC_CHG_THRESHOLD_300mA	0x06
#define ADP536X_OC_CHG_THRESHOLD_400mA	0x07

/**
 * @brief Initialize ADP536X.
 *
 * @param[in] dev_name Pointer to the device name.
 *
 * @retval 0 If the operation was successful.
 *           Otherwise, a (negative) error code is returned.
 */
int adp536x_init(const char *dev_name);

/**
 * @brief Set the VBUS current limit.
 *
 * @param[in] value The upper current threshold in LSB.
 *
 * @retval 0 If the operation was successful.
 *           Otherwise, a (negative) error code is returned.
 */
int adp536x_vbus_current_set(uint8_t value);

/**
 * @brief Set the charger current.
 *
 * @param[in] value The charger current in LSB.
 *
 * @retval 0 If the operation was successful.
 *           Otherwise, a (negative) error code is returned.
 */
int adp536x_charger_current_set(uint8_t value);

/**
 * @brief Set the charger termination voltage.
 *
 * This function configures the maximum battery voltage where
 * the charger remains active.
 *
 * @param[in] value The charger termination voltage.
 *
 * @retval 0 If the operation was successful.
 *           Otherwise, a (negative) error code is returned.
 */
int adp536x_charger_termination_voltage_set(uint8_t value);

int adp536x_charger_ldo_enable(bool enable);

/**
 * @brief Enable charging.
 *
 * @param[in] enable The requested charger operation state.
 *
 * @retval 0 If the operation was successful.
 *           Otherwise, a (negative) error code is returned.
 */
int adp536x_charging_enable(bool enable);

/**
 * @brief Read the STATUS1 register.
 *
 * @param[out] buf The read value of the STATUS1 register.
 *
 * @retval 0 If the operation was successful.
 *           Otherwise, a (negative) error code is returned.
 */
int adp536x_charger_status_1_read(uint8_t *buf);

/**
 * @brief Read the STATUS2 register.
 *
 * @param[out] buf The read value of the STATUS2 register.
 *
 * @retval 0 If the operation was successful.
 *           Otherwise, a (negative) error code is returned.
 */
int adp536x_charger_status_2_read(uint8_t *buf);

/**
 * @brief Enable charge hiccup protection mode.
 *
 * @param[in] enable The requested hiccup protection state.
 *
 * @retval 0 If the operation was successful.
 *           Otherwise, a (negative) error code is returned.
 */
int adp536x_oc_chg_hiccup_set(bool enable);

/**
 * @brief Enable discharge hiccup protection mode.
 *
 * @param[in] enable The requested hiccup protection state.
 *
 * @retval 0 If the operation was successful.
 *           Otherwise, a (negative) error code is returned.
 */
int adp536x_oc_dis_hiccup_set(bool enable);

/**
 * @brief Enable the buck/boost regulator.
 *
 * @param[in] enable The requested regulator operation state.
 *
 * @retval 0 If the operation was successful.
 *           Otherwise, a (negative) error code is returned.
 */
int adp536x_buckbst_enable(bool enable);

/**
 * @brief Set the buck regulator to 1.8 V.
 *
 * @retval 0 If the operation was successful.
 *           Otherwise, a (negative) error code is returned.
 */
int adp536x_buck_1v8_set(void);

/**
 * @brief Set the buck/boost regulator to 3.3 V.
 *
 * @retval 0 If the operation was successful.
 *           Otherwise, a (negative) error code is returned.
 */
int adp536x_buckbst_3v3_set(void);

/**
 * @brief Reset the device to its default values.
 *
 * @retval 0 If the operation was successful.
 *           Otherwise, a (negative) error code is returned.
 */
int adp536x_factory_reset(void);

/**
 * @brief Set the charge over-current threshold.
 *
 * @param[in] value The over-current threshold.
 *
 * @retval 0 If the operation was successful.
 *           Otherwise, a (negative) error code is returned.
 */
int adp536x_oc_chg_current_set(uint8_t value);

/**
 * @brief Set the buck discharge resistor status.
 *
 * @param[in] enable Boolean value to enable or disable the discharge resistor.
 *
 * @retval 0 If the operation was successful.
 *           Otherwise, a (negative) error code is returned.
 */
int adp536x_buck_discharge_set(bool enable);

int adp536x_reg_write(uint8_t reg, uint8_t val);

int adp536x_reg_read(uint8_t reg, uint8_t *buff);

#endif /* ADP536X_H_ */
```

## src/apn.c
```c
#include "apn.h"
#include "uart.h"
#include <modem/lte_lc.h>
#include <string.h>
#include <stdio.h>

const char * apn_list[] =
{
	// BG, A1
	"iot-test",

	// world, Aeris Global
	"iot.aer.net",

	// world, Sierra Global
	"lp.swir",

	// US, AT&T by Sierra
	"nmrx11.com.attz",
};

// Please group by APN so that apn_list is better sorted
struct apn_table_entry apn_table[] =
{
	// BG, A1, TODO
	{"8935901", 0},

	// world Aeirs Global
	{"891850", 1},

	// US, AT&T by Aeris
	{"890117022", 1},

	// world, Sierra Global
	{"893324", 2},

	// world, Sierra Global (eSIM)
	{"893325", 2},

	// US, AT&T by Sierra
	{"890117032", 3},
};

char out_buf[512];

const size_t apn_list_count = sizeof(apn_list) / sizeof(*apn_list);
const size_t apn_table_count = sizeof(apn_table) / sizeof(*apn_table);

struct json_obj_descr apn_get_req_descr[] =
{
	JSON_OBJ_DESCR_PRIM(struct apn_get_req, config, JSON_TOK_STRING)
};

struct json_obj_descr apn_set_req_descr[] =
{
	JSON_OBJ_DESCR_PRIM(struct apn_set_req, config, JSON_TOK_STRING),
	JSON_OBJ_DESCR_PRIM(struct apn_set_req, select, JSON_TOK_NUMBER),
	JSON_OBJ_DESCR_PRIM(struct apn_set_req, APN, JSON_TOK_STRING)
};

int apn_read(struct eeprom_apn_config * apn_config, const char * iccid)
{
	// read APN config from EEPROM
	memset(apn_config, 0, sizeof(*apn_config));
	int err = eeprom_read(eeprom_dev, EEPROM_ADDRESS_APN, apn_config, sizeof(*apn_config));

	if (OK != err)
	{
		printk("apn_read()  EEPROM read failed\n");
		return false;
	}

	bool apn_valid = false;
	uint32_t i = 0;

	for (; i < sizeof(apn_config->APN); i++)
	{
		if (!apn_config->APN[i])
		{
			apn_valid = true;
			break;
		}
	}

	for (; i < sizeof(apn_config->APN); i++)
	{
		if (apn_config->APN[i])
		{
			apn_valid = false;
			break;
		}
	}

	if (apn_valid)
	{
		if (!apn_config->APN[0])
		{
			if (apn_config->select && (apn_config->select < apn_list_count))
			{
				size_t count = strlen(apn_list[apn_config->select]);

				if (count && (count < APN_MAX_LENGTH))
				{
					memset(apn_config->APN, 0, sizeof(apn_config->APN));
					memcpy(apn_config->APN, apn_list[apn_config->select], count);

					// update the APN config in EEPROM
					err = eeprom_write(eeprom_dev, EEPROM_ADDRESS_APN, apn_config, sizeof(*apn_config));

					if (OK != err)
					{
						printk("apn_read()  EEPROM write updated APN failed\n");
					}
				}
			}
		}

		if (apn_config->APN[0])
		{
			printk("APN[%u] %s\n", apn_config->select, apn_config->APN);

			// overwrite the APN init parameters in lte_lc.c
			// static char cgdcont[144]
			// depricated API
			//- lte_lc_pdp_context_set(LTE_LC_PDP_TYPE_IP, apn_config->APN, false, false, false);
			printk("depricated API: lte_lc_pdp_context_set(LTE_LC_PDP_TYPE_IP, ...)\n");
		}
		else
		{
			printk("APN is blank\n");
			apn_valid = false;
		}
	}
	else
	{
		printk("APN not valid, setting to blank\n");
		memset(apn_config, 0, sizeof(*apn_config));
		err = eeprom_write(eeprom_dev, EEPROM_ADDRESS_APN, apn_config, sizeof(*apn_config));

		if (OK != err)
		{
			printk("apn_read()  EEPROM write blank APN failed\n");
		}
	}

	if (!apn_valid)
	{
		// fall to back to use apn_table
		for (i = 0; i < apn_table_count; ++i)
		{
			size_t len = 0;
			bool found = true;

			while (len < APN_MAX_IDENTIFIER_LENGTH)
			{
				if ('\0' == apn_table[i].identifier[len])
				{
					// we have reached end of identifier
					break;
				}

				if (apn_table[i].identifier[len] != iccid[len])
				{
					found = false;
					break;
				}

				len += 1;
			}

			if (found)
			{
				// depricated API
				//- lte_lc_pdp_context_set(
				//- 	LTE_LC_PDP_TYPE_IP,
				//- 	apn_list[apn_table[i].select],
				//- 	false,
				//- 	false,
				//- 	false
				//- );
				printk("depricated API: lte_lc_pdp_context_set(LTE_LC_PDP_TYPE_IP, ...)\n");

				printk(
					"Used APN \"%s\" for ICCID %s\n",
					apn_list[apn_table[i].select],
					iccid
				);

				break;
			}
		}
	}

	return apn_valid;
}

void apn_get(
	char * raw_buf,
	size_t len,
	struct eeprom_apn_config * apn_config
)
{
	struct apn_get_req req;

	int res = json_obj_parse(
		raw_buf,
		len,
		apn_get_req_descr,
		1,
		&req
	);

	if (1 == res)
	{
		if (0 == strcmp("eeprom", req.config))
		{
			snprintf(
				out_buf,
				sizeof(out_buf),
				"apn_eeprom={\"select\": %d, \"APN\": \"%s\"}\n",
				apn_config->select,
				apn_config->APN
			);

			uart_fota_send(out_buf, strlen(out_buf));
		}
		else if (0 == strcmp("list", req.config))
		{
			int i;

			size_t l = snprintf(
				out_buf,
				sizeof(out_buf),
				"apn_list={\"list\": ["
			);

			// len now points to the terminating NULLВ byte
			for (i = 0; i < apn_list_count; ++i)
			{
				l += snprintf(
					out_buf + l,
					sizeof(out_buf) - l,
					"\"%s\"",
					apn_list[i]
				);

				if (i != apn_list_count - 1)
				{
					l += snprintf(out_buf + l, sizeof(out_buf) - l, ", ");
				}
			}

			l += snprintf(out_buf + l, sizeof(out_buf) - l, "]}\n");
			uart_fota_send(out_buf, l);
		}
	}
}

int apn_set(char * raw_buf, size_t len, struct eeprom_apn_config * apn_config)
{
	struct apn_set_req req;

	int res = json_obj_parse(
		raw_buf,
		len,
		apn_set_req_descr,
		3,
		&req
	);

	if ((7 == res) && (0 == strcmp("eeprom", req.config)))
	{
		size_t apn_length = strlen(req.APN);

		// NULL terminator
		if (apn_length >= APN_MAX_LENGTH)
		{
			printk("apn_error={\"status\":\"APN too long\"}\n");
			return FAIL;
		}

		apn_config->select = req.select;
		memset(apn_config->APN, 0, sizeof(apn_config->APN));
		memcpy(apn_config->APN, req.APN, MIN(sizeof(apn_config->APN), apn_length));

		// update the APN config in EEPROM
		int status = eeprom_write(eeprom_dev, EEPROM_ADDRESS_APN, apn_config, sizeof(*apn_config));

		if (status)
		{
			printk("apn_error={\"status\":\"eeprom_write failed\"}\n");
		}
		else
		{
			// depricated API
			//- lte_lc_pdp_context_set(LTE_LC_PDP_TYPE_IP, apn_config->APN, false, false, false);
			printk("depricated API: lte_lc_pdp_context_set(LTE_LC_PDP_TYPE_IP, ...)\n");
		}

		return status;

	}

	return FAIL;
}
```

## src/apn.h
```c
#ifndef GUARD_APN_H
#define GUARD_APN_H

#include <zephyr.h>
#include <data/json.h>
#include "eeprom.h"

#define APN_MAX_LENGTH 32
#define APN_MAX_IDENTIFIER_LENGTH 9

struct apn_table_entry
{
#if 0
	uint8_t length;
	char identifier[APN_MAX_IDENTIFIER_LENGTH];
	char apn[APN_MAX_LENGTH];
#else
	char identifier[APN_MAX_IDENTIFIER_LENGTH];
	uint8_t select;
#endif
};

// APN config in EEPROM
struct eeprom_apn_config
{
	// 0 custom APN
	// 1-255 predefined APNs stored in the firmware
	uint8_t select;
	char APN[APN_MAX_LENGTH];
};

struct apn_get_req
{
	const char * config;
};

struct apn_set_req
{
	const char * config;
	int select;
	const char * APN;
};

int apn_read(struct eeprom_apn_config * apn_config, const char * iccid);

void apn_get(
	char * raw_buf,
	size_t len,
	struct eeprom_apn_config * apn_config
);

int apn_set(char * raw_buf, size_t len, struct eeprom_apn_config * apn_config);

#endif /* GUARD_APN_H */
```

## src/aws.c
```c
#include <zephyr.h>
#include <modem/nrf_modem_lib.h>
#include <modem/lte_lc.h>
#include <modem/modem_info.h>
#include <modem/at_cmd.h>
#include <net/socket.h>
#include <nrf_socket.h>
#include <stdio.h>
#include <net/tls_credentials.h>
#include <modem/modem_key_mgmt.h>
#include <net/mqtt.h>

#include "gpio_t.h"
#include "mqtt_handler.h"
#include "main.h"
#include "aws.h"


#define CONFIG_COAP_SERVER_PORT 61002
#define CONFIG_COAP_SERVER_HOSTNAME "84.40.94.129"

LOG_MODULE_REGISTER(aws, CONFIG_PROTEC3_LOG_LEVEL);

static struct sockaddr_storage server;

static struct rsrp_data rsrp =
{
	.value = 0,
	.offset = MODEM_INFO_RSRP_OFFSET_VAL,
};

static struct modem_param_info modem_param;

static sec_tag_t sec_tag_list[] = { 13496857 };

static const char ca_cert[] =
{
	#include "../certs/ca.crt"
};

static const char private_cert[] =
{
	#include "../certs/client.crt"
};

static const char private_key[] =
{
	#include "../certs/client.key"
};

/* Buffers for MQTT client. */
static uint8_t rx_buffer[MQTT_MESSAGE_BUFFER_SIZE];
static uint8_t tx_buffer[MQTT_MESSAGE_BUFFER_SIZE];
static uint8_t payload_buf[MQTT_PAYLOAD_BUFFER_SIZE + 1];

/* The mqtt client struct */
struct mqtt_client client;

/* MQTT Broker details. */
static struct sockaddr_storage broker;

/* Connected flag */
static bool connected;

/* File descriptor */
static struct pollfd fds;

/************************************************ Functions ********************************************/

static int server_resolve(void)
{
	int err;
	struct addrinfo * result;

	struct addrinfo hints =
	{
		.ai_flags = AI_NUMERICHOST,
		.ai_family = AF_INET,
		.ai_socktype = SOCK_DGRAM
	};

	char ipv4_addr[NET_IPV4_ADDR_LEN];

	err = getaddrinfo(CONFIG_COAP_SERVER_HOSTNAME, NULL, &hints, &result);

	if (err != 0)
	{
		LOG_ERR("ERROR: getaddrinfo failed %d\n", err);
		return -EIO;
	}

	if (result == NULL)
	{
		LOG_ERR("ERROR: Address not found\n");
		return -ENOENT;
	}

	struct sockaddr_in * server4 = ((struct sockaddr_in *)&server);

	server4->sin_addr.s_addr = ((struct sockaddr_in *)result->ai_addr)->sin_addr.s_addr;
	server4->sin_family = AF_INET;
	server4->sin_port = htons(CONFIG_COAP_SERVER_PORT);

	inet_ntop(AF_INET, &server4->sin_addr.s_addr, ipv4_addr, sizeof(ipv4_addr));
	printk("IPv4 Address found %s\n", ipv4_addr);

	freeaddrinfo(result);

	return 0;
}

static void modem_rsrp_handler(char rsrp_value)
{
	if (rsrp_value > 97)
	{
		return;
	}

	rsrp.value = rsrp_value;

	char buffer[CONFIG_MODEM_INFO_BUFFER_SIZE] = { 0 };
	int32_t rsrp_current;
	size_t len;
	rsrp_current = rsrp.value - rsrp.offset;

	len = snprintf(buffer, CONFIG_MODEM_INFO_BUFFER_SIZE, "signal strength: %d dBm", rsrp_current);
	printk("%s\n", buffer);

}

static void modem_data_init(void)
{
	int err;
	err = modem_info_init();

	if (err)
	{
		printk("Modem info could not be established: %d\n", err);
		return;
	}

	modem_info_params_init(&modem_param);
	modem_info_rsrp_register(modem_rsrp_handler);
}

int cert_provision1(nrf_sec_tag_t sec_tag, enum modem_key_mgmt_cred_type cred_type, const void * buf, size_t len)
{
	int err;
	bool exists;
	uint8_t unused;

	err = modem_key_mgmt_exists(
		sec_tag,
		cred_type,
		&exists,
		&unused
	);

	if (err)
	{
		printk("Failed to check for certificates err %d\n", err);
		return err;
	}

	//	if (exists)
	//	{
	//		/* For the sake of simplicity we delete what is provisioned
	//		 * with our security tag and reprovision our certificate.
	//		 */
	//		err = modem_key_mgmt_delete(sec_tag, cred_type);
	//
	//		if (err)
	//		{
	//			printk("Failed to delete existing certificate, err %d\n", err);
	//		}
	//	}


	if (!exists)
	{
		printk("Provisioning certificate\n");

		/*  Provision certificate to the modem */
		err = modem_key_mgmt_write(sec_tag, cred_type, buf, len - 1);

		if (err)
		{
			printk("Failed to provision certificate, err %d\n", err);
			return err;
		}
	}
	else
	{
		printk("Certificate already provisioned\n");
	}


	return 0;
}

/* TODO should be a libary function, but I couldn't get the library included
   cf. https://developer.nordicsemi.com/nRF_Connect_SDK/doc/latest/zephyr/reference/random/index.html?highlight=sys_rand#c.sys_rand32_get
 */
uint32_t sys_rand32_get(void)
{
	/* algorithm from EUROS soruces */
	static uint32_t seed = 0;

	if (!seed)
	{
		seed = k_uptime_get_32();
	}

	seed = seed * 1103515245L + 12345L;

	return seed >> 16;
}

/**@brief Function to print strings without null-termination
 */
static void data_print(const uint8_t * prefix, const uint8_t * data, size_t len)
{
	char buf[len + 1];

	memcpy(buf, data, len);
	buf[len] = 0;
	printk("%s%s\n", prefix, buf);
}

int data_publish1(
	struct mqtt_client * c,
	enum mqtt_qos qos,
	const uint8_t * subtopic,
	/*const */uint8_t * data
)
{
	uint8_t topic[64];
	struct mqtt_publish_param param;

	snprintf(topic, sizeof(topic), "/%s%s", client_id_buf, subtopic);

	param.message.topic.qos = qos;
	param.message.topic.topic.utf8 = topic;
	param.message.topic.topic.size = strlen(topic);
	param.message.payload.data = data;
	param.message.payload.len = strlen(data);
	param.message_id = sys_rand32_get();
	param.dup_flag = 0;
	param.retain_flag = 0;

	printk("MQTT PUB: %s = ", topic);
	data_print("", data, strlen(data));

	return mqtt_publish(c, &param);
}



/**@brief Function to subscribe to the configured topic
 */
static int subscribe(void)
{
	uint8_t alarm[64];
	uint8_t beep[64];
	uint8_t led_[64];
	uint8_t user[64];
	uint8_t uptime[64];

	snprintf(alarm, sizeof(alarm), "/%s/alarm", client_id_buf);
	snprintf(beep, sizeof(beep), "/%s/beep/+", client_id_buf);
	snprintf(led_, sizeof(led_), "/%s/led/+", client_id_buf);
	snprintf(user, sizeof(user), "/%s/user/+", client_id_buf);
	snprintf(uptime, sizeof(uptime), "/%s/uptime", client_id_buf);

	struct mqtt_topic subscribe_topics[] =
	{
		{
			.topic =
			{
				.utf8 = alarm,
				.size = strlen(alarm)
			},
			.qos = MQTT_QOS_1_AT_LEAST_ONCE
		},
		{
			.topic =
			{
				.utf8 = beep,
				.size = strlen(beep)
			},
			.qos = MQTT_QOS_1_AT_LEAST_ONCE
		},
		{
			.topic =
			{
				.utf8 = led_,
				.size = strlen(led_)
			},
			.qos = MQTT_QOS_1_AT_LEAST_ONCE
		},
		{
			.topic =
			{
				.utf8 = user,
				.size = strlen(user)
			},
			.qos = MQTT_QOS_1_AT_LEAST_ONCE
		},
		{
			.topic =
			{
				.utf8 = uptime,
				.size = strlen(uptime)
			},
			.qos = MQTT_QOS_1_AT_LEAST_ONCE
		},
		// TODO add additional topics
	};

	size_t count = sizeof(subscribe_topics) / sizeof(subscribe_topics[0]);

	const struct mqtt_subscription_list subscription_list =
	{
		.list = subscribe_topics,
		.list_count = count,
		.message_id = 1234
	};

	printk("\nMQTT subscribing to %u topics:\n", count);

	size_t i = 0;

	for (i = 0; i < count; i++)
	{
		printk("  %s\n", subscribe_topics[i].topic.utf8);
	}

	printk("\n");

	return mqtt_subscribe(&client, &subscription_list);
}

/**@brief Function to read the published payload.
 */
static int publish_get_payload(struct mqtt_client * c, size_t length)
{
	// reserve space for a NULL terminator
	if (length >= sizeof(payload_buf))
	{
		return -EMSGSIZE;
	}

	uint8_t * buf = payload_buf;
	uint8_t * end = buf + length;

	while (buf < end)
	{
		int count = mqtt_read_publish_payload(c, buf, end - buf);

		if (count < 0)
		{
			int err;

			if (count != -EAGAIN)
			{
				return count;
			}

			printk("mqtt_read_publish_payload: EAGAIN\n");

			err = poll(&fds, 1, CONFIG_MQTT_KEEPALIVE * MSEC_PER_SEC);

			if (err > 0 && (fds.revents & POLLIN) == POLLIN)
			{
				continue;
			}
			else
			{
				return -EIO;
			}
		}

		if (count == 0)
		{
			return -EIO;
		}

		buf += count;
	}

	// add a NULL terminator
	*buf = '\0';

	return 0;
}

/**@brief MQTT client event handler
 */
void mqtt_evt_handler(struct mqtt_client * const c, const struct mqtt_evt * evt)
{
	int err;

	switch (evt->type)
	{
	case MQTT_EVT_CONNACK:
		if (evt->result != 0)
		{
			printk("MQTT connect failed %d\n", evt->result);
			break;
		}

		connected = true;
		printk("[%s:%d] MQTT client connected!\n", __func__, __LINE__);
		int b = subscribe();

		printk(
			"MQTT mqtt_subscribe %i  %s\n",
			b,
			(b == -12) ? "FAIL: check MQTT_MESSAGE_BUFFER_SIZE" : b ? "FAIL" : "OK"
		);

		data_publish1(&client, MQTT_QOS_1_AT_LEAST_ONCE, "/status/link", "ONLINE");

		break;

	case MQTT_EVT_DISCONNECT:
		printk(
			"[%s:%d] MQTT client disconnected %d\n",
			__func__,
			__LINE__,
			evt->result
		);

		connected = false;

		break;

	case MQTT_EVT_PUBLISH:
	{
		const struct mqtt_publish_param * p = &evt->param.publish;

		uint8_t topic[p->message.topic.topic.size + 1];
		snprintf(topic, sizeof(topic), "%s", p->message.topic.topic.utf8);

		printk(
			"[%s:%d] MQTT PUBLISH result=%d len=%d  %s = ",
			__func__,
			__LINE__,
			evt->result,
			p->message.payload.len,
			topic
		);

		err = publish_get_payload(c, p->message.payload.len);

		if (err >= 0)
		{
			printk("%s\n", payload_buf);
			mqtt_publish_h(&client, topic, strlen(topic), payload_buf, p->message.payload.len);

#if 0
			data_publish1(
				&client,
				MQTT_QOS_1_AT_LEAST_ONCE,
				"/status/echo",
				payload_buf
				/*, p->message.payload.len*/
			);
#endif
		}
		else
		{
			printk("ERROR %d\nmqtt_read_publish_payload: Failed!\n", err);
			printk("Disconnecting MQTT client...\n");

			err = mqtt_disconnect(c);

			if (err)
			{
				printk("Could not disconnect: %d\n", err);
			}
		}
	}

	break;

	case MQTT_EVT_PUBACK:
		if (evt->result != 0)
		{
			printk("MQTT PUBACK error %d\n", evt->result);
			break;
		}

		printk(
			"[%s:%d] PUBACK packet id: %u\n",
			__func__,
			__LINE__,
			evt->param.puback.message_id
		);

		break;

	case MQTT_EVT_SUBACK:
		if (evt->result != 0)
		{
			printk("MQTT SUBACK error %d\n", evt->result);
			break;
		}

		printk(
			"[%s:%d] SUBACK packet id: %u\n",
			__func__,
			__LINE__,
			evt->param.suback.message_id
		);

		break;

	default:
		printk(
			"[%s:%d] default: %d\n",
			__func__,
			__LINE__,
			evt->type
		);

		break;
	}
}

/**@brief Resolves the configured hostname and
 * initializes the MQTT broker structure
 */
static void broker_init(void)
{
	int err;
	struct addrinfo * result;
	struct addrinfo * addr;
	struct addrinfo hints =
	{
		.ai_family = AF_INET,
		.ai_socktype = SOCK_STREAM
	};


	struct nrf_in_addr dns;
	dns.s_addr = 0x08080808; // Google DNS, 8.8.8.8
	err = nrf_setdnsaddr(NRF_AF_INET, &dns);
	printk("LTE| set DNS: %d\n", err);

	err = getaddrinfo(MQTT_BROKER_HOSTNAME, NULL, &hints, &result);

	if (err)
	{
		printk("ERROR: getaddrinfo failed %d\n", err);

		return;
	}

	addr = result;
	err = -ENOENT;

	/* Look for address of the broker. */
	while (addr != NULL)
	{
		/* IPv4 Address. */
		if (addr->ai_addrlen == sizeof(struct sockaddr_in))
		{
			struct sockaddr_in * broker4 = ((struct sockaddr_in *)&broker);
			char ipv4_addr[NET_IPV4_ADDR_LEN];

			broker4->sin_addr.s_addr = ((struct sockaddr_in *)addr->ai_addr)->sin_addr.s_addr;
			broker4->sin_family = AF_INET;
			broker4->sin_port = htons(MQTT_BROKER_PORT);

			inet_ntop(AF_INET, &broker4->sin_addr.s_addr, ipv4_addr, sizeof(ipv4_addr));
			printk("IPv4 Address found %s\n", ipv4_addr);

			break;
		}
		else
		{
			printk(
				"ai_addrlen = %u should be %u or %u\n",
				(unsigned int)addr->ai_addrlen,
				(unsigned int)sizeof(struct sockaddr_in),
				(unsigned int)sizeof(struct sockaddr_in6)
			);
		}

		addr = addr->ai_next;
		break;
	}

	/* Free the address. */
	freeaddrinfo(result);
}

/**@brief Initialize the MQTT client structure
 */
static void client_init(struct mqtt_client * client)
{
	static struct mqtt_utf8 password;
	static struct mqtt_utf8 user_name;
	static struct mqtt_utf8 will_message;
	static struct mqtt_topic will_topic;
	static struct mqtt_utf8 will_topic_topic;

	static uint8_t client_id[64];
	static uint8_t topic[64];

	mqtt_client_init(client);

	broker_init();

	/* MQTT client configuration */
	client->broker = &broker;
	client->evt_cb = mqtt_evt_handler;

	snprintf(client_id, sizeof(client_id), "protec3-%s", client_id_buf);
	client->client_id.utf8 = (uint8_t *)client_id;
	client->client_id.size = strlen(client_id);

	password.utf8 = MQTT_CLIENT_PASSWORD;
	password.size = strlen(password.utf8);
	client->password = &password;

	user_name.utf8 = (uint8_t *)MQTT_CLIENT_USERNAME;
	user_name.size = strlen(user_name.utf8);
	client->user_name = &user_name;

	will_message.utf8 = (uint8_t *)"OFFLINE";
	will_message.size = strlen(will_message.utf8);
	client->will_message = &will_message;

	snprintf(topic, sizeof(topic), "/%s/status/link", client_id_buf);
	will_topic_topic.utf8 = topic;
	will_topic_topic.size = strlen(topic);

	will_topic.qos = MQTT_QOS_2_EXACTLY_ONCE;
	will_topic.topic = will_topic_topic;
	client->will_topic = &will_topic;

	client->protocol_version = MQTT_VERSION_3_1_1;

	//printk("username: %s, password: %s\n", client->user_name->utf8, client->password->utf8);

	/* MQTT buffers configuration */
	client->rx_buf = rx_buffer;
	client->rx_buf_size = sizeof(rx_buffer);
	client->tx_buf = tx_buffer;
	client->tx_buf_size = sizeof(tx_buffer);

	/* MQTT transport configuration */
#if defined(CONFIG_MQTT_LIB_TLS)
	struct mqtt_sec_config * tls_config = &client->transport.tls.config;

	client->transport.type = MQTT_TRANSPORT_SECURE;

	tls_config->peer_verify = PEER_VERIFY;
	tls_config->cipher_count = 0;
	tls_config->cipher_list = NULL;
	tls_config->sec_tag_count = ARRAY_SIZE(sec_tag_list);
	tls_config->sec_tag_list = sec_tag_list;
	tls_config->hostname = MQTT_BROKER_HOSTNAME;
#else /* MQTT transport configuration */
	client->transport.type = MQTT_TRANSPORT_NON_SECURE;
#endif /* defined(CONFIG_MQTT_LIB_TLS) */

		/* worker_queue to handle received data */
		mqtt_work_queue_init();
}

/**@brief Initialize the file descriptor structure used by poll.
 */
static int fds_init(struct mqtt_client * c)
{
	if (c->transport.type == MQTT_TRANSPORT_NON_SECURE)
	{
		fds.fd = c->transport.tcp.sock;
	}
	else
	{
#if defined(CONFIG_MQTT_LIB_TLS)
		fds.fd = c->transport.tls.sock;
#else
		return -ENOTSUP;
#endif
	}

	fds.events = POLLIN;

	return 0;
}

void modem_thread(void)
{
	struct modem_param_info * modem_ptr = NULL;
	int ret, err;

	char buffer[CONFIG_MESSAGE_BUFFER_SIZE] = { 0 };

	k_msleep(100);
	printk("Starting LTE link initialization\n");

	/* Provision certificates before connecting to the LTE network */
	err = cert_provision1(
		sec_tag_list[0],
		MODEM_KEY_MGMT_CRED_TYPE_CA_CHAIN,
		ca_cert,
		sizeof(ca_cert)
	);

	if (err)
	{
		printk("Failed to install ca_cert\n");
	}

	err = cert_provision1(
		sec_tag_list[0],
		MODEM_KEY_MGMT_CRED_TYPE_PUBLIC_CERT,
		private_cert,
		sizeof(private_cert)
	);

	if (err)
	{
		printk("Failed to install client cert\n");
	}

	err = cert_provision1(
		sec_tag_list[0],
		MODEM_KEY_MGMT_CRED_TYPE_PRIVATE_CERT,
		private_key,
		sizeof(private_key)
	);

	if (err)
	{
		printk("Failed to install client key\n");
	}

	// init button and LED
	led_init();
	//+btn_init();
	lte_init();

	k_sem_take(&thread_sync_sem, K_FOREVER);

	//lte_lc_init_and_connect();
	server_resolve();
	printk("LTE link initialization done\n");

	client_init(&client);

	modem_data_init();

	while (1)
	{
		ret = modem_info_params_get(&modem_param);

		if (ret < 0)
		{
			printk("Unable to obtain modem parameters: %d\n", ret);
		}
		else
		{
			modem_ptr = &modem_param;

			if (IS_ENABLED(CONFIG_MODEM_INFO_ADD_NETWORK))
			{
				snprintf(
					buffer,
					CONFIG_MESSAGE_BUFFER_SIZE,
					"operator id: %s, area code: %s (%d), cell id: %s (%d), band: %d, ip: %s, apn: %s, mode: %s",
					modem_ptr->network.current_operator.value_string,
					modem_ptr->network.area_code.value_string,
					modem_ptr->network.area_code.value,
					modem_ptr->network.cellid_hex.value_string,
					(int)modem_ptr->network.cellid_dec,
					modem_ptr->network.current_band.value,
					modem_ptr->network.ip_address.value_string,
					modem_ptr->network.apn.value_string,
					(modem_ptr->network.nbiot_mode.value == 1 && modem_ptr->network.gps_mode.value == 1 ? "NB-IoT, GPS" :
						(modem_ptr->network.lte_mode.value == 1 && modem_ptr->network.gps_mode.value == 1 ? "LTE-M, GPS" :
							(modem_ptr->network.nbiot_mode.value == 0 && modem_ptr->network.lte_mode.value == 0 && modem_ptr->network.gps_mode.value == 1 ? "GPS" :
								"unknown"
								)
							)
						)
				);

				printk("%s\n", buffer);

				if (IS_ENABLED(CONFIG_MODEM_INFO_ADD_DATE_TIME))
				{
					snprintf(buffer, CONFIG_MESSAGE_BUFFER_SIZE, "network time: %s", modem_ptr->network.date_time.value_string);
					printk("%s\n", buffer);
				}
			}
		}

		err = mqtt_connect(&client);

		if (err != 0)
		{
			printk("ERROR: mqtt_connect %d\n", err);
			//return;
		}
		else
		{

			err = fds_init(&client);

			if (err != 0)
			{
				printk("ERROR: fds_init %d\n", err);
				//return;
			}
			else
			{

				while (1)
				{
					err = poll(&fds, 1, mqtt_keepalive_time_left(&client));

					if (err < 0)
					{
						printk("ERROR: poll %d\n", errno);
						break;
					}

					err = mqtt_live(&client);

					if ((err != 0) && (err != -EAGAIN))
					{
						printk("ERROR: mqtt_live %d\n", err);
						break;
					}

					if ((fds.revents & POLLIN) == POLLIN)
					{
						err = mqtt_input(&client);
						if (err != 0)
						{
							printk("ERROR: mqtt_input %d\n", err);
							break;
						}
					}

					if ((fds.revents & POLLERR) == POLLERR)
					{
						printk("POLLERR\n");
						break;
					}

					if ((fds.revents & POLLNVAL) == POLLNVAL)
					{
						printk("POLLNVAL\n");
						break;
					}

				}

				printk("Disconnecting MQTT client...\n");

				err = mqtt_disconnect(&client);

				if (err)
				{
					printk("Could not disconnect MQTT client. Error: %d\n", err);
				}
			}
		}

		k_sleep(K_SECONDS(30));
	}
}


K_THREAD_DEFINE(modem_thread_id, 4096, modem_thread, NULL, NULL, NULL, 7, 0, 0);
```

## src/aws.h
```c
#ifndef GUARD_AWS_H
#define GUARD_AWS_H

// at least 256
#define MQTT_MESSAGE_BUFFER_SIZE 512

// at least 128
#define MQTT_PAYLOAD_BUFFER_SIZE 512

#define MQTT_CLIENT_USERNAME "protec3.io"
#define MQTT_CLIENT_PASSWORD "kR59Tq72d%.SX}4aze!^1KX_+nJBRy&T"
#define PEER_VERIFY 2
#define MQTT_BROKER_HOSTNAME "protec3.io"
#define MQTT_BROKER_PORT 5883

struct rsrp_data
{
	uint16_t value;
	uint16_t offset;
};

extern struct mqtt_client client;


#endif /* GUARD_AWS_H */
```

## src/bme280.c
```c
/*
 * Copyright (c) 2016 Open-RnD Sp. z o.o.
 * Copyright (c) 2020 Nordic Semiconductor ASA
 *
 * SPDX-License-Identifier: Apache-2.0
 */

#include <zephyr.h>
#include <stdio.h>
#include <device.h>
#include <inttypes.h>
#include <string.h>
#include <nrf_modem.h>
#include <sys/util.h>
#include <sys/printk.h>
#include <drivers/gpio.h>
#include <drivers/uart.h>
#include <drivers/i2c.h>
#include <drivers/eeprom.h>
#include <drivers/sensor.h>
#include <modem/nrf_modem_lib.h>
#include <modem/lte_lc.h>
#include <modem/modem_info.h>
#include <modem/at_cmd.h>
#include <net/socket.h>
#include <nrf_socket.h>
#include <power/reboot.h>

#include <adp536x-mod.h>
#include <buzzer.h>


 /********************* BME280 ******************************************/
#include "BME280_driver-bme280_v3.5.0/bme280.h"
/********************** END BME *****************************************/


/********************** BME280 ******************************************/
typedef struct
{
	const struct device * i2c2_dev;
	uint16_t dev_addr;
} tDevDataForBME;

/*!
 * @brief Bus communication function pointer which should be mapped to
 * the platform specific read functions of the user
 *
 * @param[in] reg_addr       : Register address from which data is read.
 * @param[out] reg_data      : Pointer to data buffer where read data is stored.
 * @param[in] len            : Number of bytes of data to be read.
 * @param[in, out] intf_ptr  : Void pointer that can enable the linking of descriptors
 *                                  for interface related call backs.
 *
 * @retval   0 -> Success.
 * @retval Non zero value -> Fail.
 *
 */
static BME280_INTF_RET_TYPE bme280_i2c_read(uint8_t reg_addr, uint8_t * reg_data, uint32_t len, void * intf_ptr)
{
	tDevDataForBME * devData = (tDevDataForBME *)intf_ptr;

	return i2c_write_read(
		devData->i2c2_dev,
		devData->dev_addr,
		&reg_addr,
		sizeof(reg_addr),
		reg_data,
		len
	);
}

/*!
 * @brief Bus communication function pointer which should be mapped to
 * the platform specific write functions of the user
 *
 * @param[in] reg_addr      : Register address to which the data is written.
 * @param[in] reg_data      : Pointer to data buffer in which data to be written
 *                            is stored.
 * @param[in] len           : Number of bytes of data to be written.
 * @param[in, out] intf_ptr : Void pointer that can enable the linking of descriptors
 *                            for interface related call backs
 *
 * @retval   0   -> Success.
 * @retval Non zero value -> Fail.
 *
 */
static BME280_INTF_RET_TYPE bme280_i2c_write(uint8_t reg_addr, const uint8_t * reg_data, uint32_t len, void * intf_ptr)
{
	tDevDataForBME * devData = (tDevDataForBME *)intf_ptr;

	return i2c_burst_write(
		devData->i2c2_dev,
		devData->dev_addr,
		reg_addr,
		reg_data,
		len
	);
}

/*!
 * @brief Delay function pointer which should be mapped to
 * delay function of the user
 *
 * @param[in] period              : Delay in microseconds.
 * @param[in, out] intf_ptr       : Void pointer that can enable the linking of descriptors
 *                                  for interface related call backs
 *
 */
static void bme280_delay(uint32_t period, void * intf_ptr)
{
	k_usleep(period);
}

void bme280_print_sensor_data(struct bme280_data * comp_data)
{
#ifdef BME280_FLOAT_ENABLE
	printf("%0.2f, %0.2f, %0.2f\r\n", comp_data->temperature, comp_data->pressure, comp_data->humidity);
#else
	printf("%ld, %ld, %ld\r\n", comp_data->temperature, comp_data->pressure, comp_data->humidity);
#endif
}

void bme280_init_api(const struct device * i2c_dev)
{
	struct bme280_dev dev;
	int8_t rslt = BME280_OK;
	tDevDataForBME devDataForBME = { i2c_dev, BME280_I2C_ADDR_SEC };

	dev.intf_ptr = &devDataForBME;
	dev.intf = BME280_I2C_INTF;
	dev.read = bme280_i2c_read;
	dev.write = bme280_i2c_write;
	dev.delay_us = bme280_delay;
	rslt = bme280_init(&dev);

	if (BME280_OK == rslt)
	{
		uint8_t settings_sel;
		struct bme280_data comp_data;

		/* Recommended mode of operation: Indoor navigation */
		dev.settings.osr_h = BME280_OVERSAMPLING_1X;
		dev.settings.osr_p = BME280_OVERSAMPLING_16X;
		dev.settings.osr_t = BME280_OVERSAMPLING_2X;
		dev.settings.filter = BME280_FILTER_COEFF_16;
		dev.settings.standby_time = BME280_STANDBY_TIME_62_5_MS;

		settings_sel = BME280_OSR_PRESS_SEL;
		settings_sel |= BME280_OSR_TEMP_SEL;
		settings_sel |= BME280_OSR_HUM_SEL;
		settings_sel |= BME280_STANDBY_SEL;
		settings_sel |= BME280_FILTER_SEL;

		rslt = bme280_set_sensor_settings(settings_sel, &dev);
		rslt = bme280_set_sensor_mode(BME280_NORMAL_MODE, &dev);
		printf("BME280: Temperature, Pressure, Humidity\r\n");

		dev.delay_us(70, dev.intf_ptr);

		rslt = bme280_get_sensor_data(BME280_ALL, &comp_data, &dev);
		bme280_print_sensor_data(&comp_data);
	}
	else
	{
		printk("bme280_init_api() failed %d\n", rslt);
	}
}

/********************** END BME *****************************************/
```

## src/buzzer.c
```c
/*
 * Copyright (c) 2019 Nordic Semiconductor ASA
 *
 * SPDX-License-Identifier: LicenseRef-BSD-5-Clause-Nordic
 */

#include <zephyr.h>
#include <drivers/pwm.h>
#include <drivers/gpio.h>

 //#include "ui.h"

#include <logging/log.h>
LOG_MODULE_REGISTER(buzzer, 3);

#define CONFIG_UI_BUZZER_PWM_DEV_NAME "PWM_1"
#define CONFIG_UI_BUZZER_PIN 0
#define CONFIG_UI_BUZZER_MIN_FREQUENCY 1000
#define CONFIG_UI_BUZZER_MAX_FREQUENCY 5000

#define BUZZER_MIN_FREQUENCY		CONFIG_UI_BUZZER_MIN_FREQUENCY
#define BUZZER_MAX_FREQUENCY		CONFIG_UI_BUZZER_MAX_FREQUENCY
#define BUZZER_MIN_INTENSITY		0
#define BUZZER_MAX_INTENSITY		100
#define BUZZER_MIN_DUTY_CYCLE_DIV	100
#define BUZZER_MAX_DUTY_CYCLE_DIV	2

#define BUZZER_ENABLE_PIN 2

const struct device * pwm_dev;
const struct device * gpio0;
static atomic_t buzzer_enabled;

static uint32_t intensity_to_duty_cycle_divisor(uint8_t intensity)
{
	return MIN(
		MAX(
			((intensity - BUZZER_MIN_INTENSITY) *
				(BUZZER_MAX_DUTY_CYCLE_DIV - BUZZER_MIN_DUTY_CYCLE_DIV) /
				(BUZZER_MAX_INTENSITY - BUZZER_MIN_INTENSITY) +
				BUZZER_MIN_DUTY_CYCLE_DIV),
			BUZZER_MAX_DUTY_CYCLE_DIV),
		BUZZER_MIN_DUTY_CYCLE_DIV);
}

static int pwm_out(uint32_t frequency, uint8_t intensity)
{
	static uint32_t prev_period;
	uint32_t period = (frequency > 0) ? USEC_PER_SEC / frequency : 0;
	uint32_t duty_cycle = (intensity == 0) ?
		0 : period / intensity_to_duty_cycle_divisor(intensity);

	/* Applying workaround due to limitations in PWM driver that doesn't
	 * allow changing period while PWM is running. Setting pulse to 0
	 * disables the PWM, but not before the current period is finished.
	 */
	if (prev_period)
	{
		pwm_pin_set_usec(pwm_dev, CONFIG_UI_BUZZER_PIN, prev_period, 0, 0);
		k_sleep(K_MSEC(MAX((prev_period / USEC_PER_MSEC), 1)));
	}

	prev_period = period;

	return pwm_pin_set_usec(
		pwm_dev,
		CONFIG_UI_BUZZER_PIN,
		period,
		duty_cycle,
		0
	);
}

static void buzzer_disable(void)
{
	atomic_set(&buzzer_enabled, 0);

	pwm_out(0, 0);
	gpio_pin_set(gpio0, BUZZER_ENABLE_PIN, 0);


#ifdef CONFIG_DEVICE_POWER_MANAGEMENT
	int err = device_set_power_state(pwm_dev, DEVICE_PM_SUSPEND_STATE, NULL, NULL);

	if (err)
	{
		LOG_ERR("PWM disable failed");
	}
#endif
}

static int buzzer_enable(void)
{
	int err = 0;

	atomic_set(&buzzer_enabled, 1);
	gpio_pin_set(gpio0, BUZZER_ENABLE_PIN, 1);

#ifdef CONFIG_DEVICE_POWER_MANAGEMENT
	err = device_set_power_state(pwm_dev, DEVICE_PM_ACTIVE_STATE, NULL, NULL);

	if (err)
	{
		LOG_ERR("PWM enable failed");
		return err;
	}
#endif

	return err;
}

int ui_buzzer_init(void)
{
	const char * dev_name = CONFIG_UI_BUZZER_PWM_DEV_NAME;
	int err = 0;

	gpio0 = device_get_binding("GPIO_0");

	if (gpio0)
	{
		if (
			gpio_pin_configure(gpio0, 1, GPIO_OUTPUT) == 0 &&
			gpio_pin_configure(gpio0, BUZZER_ENABLE_PIN, GPIO_OUTPUT) == 0
			)
		{
			if (
				gpio_pin_set(gpio0, 1, 0) == 0 &&
				gpio_pin_set(gpio0, BUZZER_ENABLE_PIN, 0) == 0
				)
			{
				pwm_dev = device_get_binding(dev_name);

				if (!pwm_dev)
				{
					LOG_ERR("Could not bind to device %s", log_strdup(dev_name));
					err = -ENODEV;
				}
			}
		}
	}

	//buzzer_enable();

	return err;
}

int ui_buzzer_set_frequency(uint32_t frequency, uint8_t intensity)
{
	if (frequency == 0 || intensity == 0)
	{
		LOG_DBG("Frequency set to 0, disabling PWM\n");
		buzzer_disable();
		return 0;
	}

	if (
		(frequency < BUZZER_MIN_FREQUENCY) ||
		(frequency > BUZZER_MAX_FREQUENCY)
		)
	{
		return -EINVAL;
	}

	if (
		(intensity < BUZZER_MIN_INTENSITY) ||
		(intensity > BUZZER_MAX_INTENSITY)
		)
	{
		return -EINVAL;
	}

	if (!atomic_get(&buzzer_enabled))
	{
		buzzer_enable();
	}

	return pwm_out(frequency, intensity);
}
```

## src/buzzer.h
```c
/*
 * Copyright (c) 2019 Nordic Semiconductor ASA
 *
 * SPDX-License-Identifier: LicenseRef-BSD-5-Clause-Nordic
 */
/**@file
 *
 * @brief   Buzzer control for the User Interface module. The module uses PWM to
 *	    control the buzzer output frequency.
 */

#ifndef UI_BUZZER_H__
#define UI_BUZZER_H__

#include <zephyr.h>

#ifdef __cplusplus
extern "C" {
#endif

/**@brief Initialize buzzer in the user interface module. */
int ui_buzzer_init(void);
int ui_buzzer_set_frequency(uint32_t frequency, uint8_t intensity);

#ifdef __cplusplus
}
#endif

#endif /* UI_BUZZER_H__ */
```

## src/eeprom.h
```c
#ifndef GUARD_EEPROM_H
#define GUARD_EEPROM_H

#include <drivers/eeprom.h>

#define OK 0
#define FAIL -1

extern const struct device * eeprom_dev;
extern struct eeprom_apn_config apn_config;

// EEPROM layout
enum EEPROM_ADDRESS
{
	EEPROM_ADDRESS_STARTUP_COUNT = 0,
	EEPROM_ADDRESS_UPDATE_STATUS = 4,
	EEPROM_ADDRESS_APN = 5,
};

#endif /*GUARD_EEPROM_H*/
```

## src/fota_update.h
```c
#ifndef GUARD_FOTA_UPDATE_H
#define GUARD_FOTA_UPDATE_H

// receive len bytes into buf; if look_for_newline is set, only if a newline was received
// if flush is set flush buffer instead
typedef int (*fota_recv_t)(uint8_t * buf, size_t len, int look_for_newline, int flush);

// send len bytes from buf
typedef int (*fota_send_t)(const uint8_t * buf, size_t len);

//clean up duties in case of error, e. g. disconnect
typedef void (*fota_finish_t)(void);

void fota_uart_start(size_t file_size, uint8_t sha1[20], fota_finish_t fota_finish);
void fota_uart_init(fota_recv_t fota_recv, fota_send_t fota_send);
void fota_update_notify(void);

uint8_t strtou8(const char * s);

#endif /* GUARD_FOTA_UPDATE_H */
```

## src/gpio_t.c
```c
/*
 * Copyright (c) 2020 EUROS Embedded Systems GmbH
 *
 * SPDX-License-Identifier: Apache-2.0
 */

#include <zephyr.h>
#include <nrf_socket.h>
#include <net/socket.h>
#include <sys/types.h>
#include <device.h>
#include <devicetree.h>
#include <drivers/gpio.h>
#include <drivers/sensor.h>
#include <stdio.h>
#include <string.h>

 // LTE modem
#include <modem/at_cmd.h>
#include <modem/at_notif.h>
#include <modem/nrf_modem_lib.h>
#include <modem/lte_lc.h>
#include <modem/modem_info.h>

#include "gpio_t.h"


// LED
struct LEDS_t led;


int led_init(void)
{
	int b = OK;
	size_t i = 0;

	memset(&led, 0, sizeof(led));

	if ((LED_COUNT != LED_COUNT_PINS) || (LED_COUNT != LED_COUNT_FLAGS))
	{
		printk("led_init()  led_names, led_nodes, and led_flags should have the same length\n");
		return FAIL;
	}

	for (i = 0; i < LED_COUNT; i++)
	{
		led.list[i].dev = device_get_binding(led_names[i]);
		led.list[i].pin = led_pins[i];

		// include GPIO_INPUT so we can read the state of the output using pin_get()
		if (
			!led.list[i].dev ||
			(gpio_pin_configure(
				led.list[i].dev,
				led.list[i].pin,
				led_flags[i] | GPIO_INPUT | GPIO_OUTPUT_INACTIVE
			) < 0)
			)
		{
			led.list[i].dev = NULL;
			b = FAIL;
		}
	}

	return b;
}

int pin_get(struct PIN_obj_t pin)
{
	if (!pin.dev)
	{
		return 0;
	}

	return gpio_pin_get(pin.dev, pin.pin);
}

int pin_set(struct PIN_obj_t pin, int on)
{
	if (!pin.dev)
	{
		return FAIL;
	}

	return gpio_pin_set(pin.dev, pin.pin, on);
}

int led_set_rgb(struct LED_t * led, int r, int g, int b)
{
	int err = 0;
	err |= pin_set(led->r, r);
	err |= pin_set(led->g, g);
	err |= pin_set(led->b, b);

	return err;
}


// BUTTONS
static struct gpio_callback btn_0_cb_data;
struct PIN_obj_t btn_0;
int btn_0_trigger = 0;

void btn_0_pressed(const struct device * dev, struct gpio_callback * cb, uint32_t pins)
{
	btn_0_trigger = 1;
	led_set_rgb(&led.sense, 1, 1, 1);
}

int btn_init(void)
{
	int b = OK;

	btn_0.dev = device_get_binding(BTN_0);
	btn_0.pin = BTN_0_PIN;

	if (
		!btn_0.dev ||
		(OK != gpio_pin_configure(btn_0.dev, btn_0.pin, BTN_0_FLAGS | GPIO_INPUT)) ||
		(OK != gpio_pin_interrupt_configure(btn_0.dev, btn_0.pin, GPIO_INT_EDGE_TO_ACTIVE))
		)
	{
		btn_0.dev = NULL;
		b = FAIL;
	}
	else
	{
		gpio_init_callback(&btn_0_cb_data, btn_0_pressed, BIT(btn_0.pin));
		gpio_add_callback(btn_0.dev, &btn_0_cb_data);
	}

	return OK;
}
```
